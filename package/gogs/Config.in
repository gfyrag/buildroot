## package/gogs/Config.in
```kconfig
config BR2_PACKAGE_GOGS
    bool "gogs"
    help
        Gogs - Go Git Service

        http://gogs.io/
```

## package/golang/Config.in
```kconfig
comment "golang needs a toolchain w/ threads"
	depends on !BR2_PACKAGE_GOLANG_ARCH_SUPPORTS
	depends on !BR2_TOOLCHAIN_HAS_THREADS

# golang only supports x86, x86_64 and ARM targets.
# For ARM, armv5 or above is required.
config BR2_PACKAGE_GOLANG_ARCH_SUPPORTS
	bool
	default y
	depends on BR2_USE_MMU
	depends on BR2_i386 || BR2_x86_64 || BR2_arm
	depends on !BR2_ARM_CPU_ARMV4

config BR2_PACKAGE_GOLANG
	bool "golang"
	depends on BR2_PACKAGE_GOLANG_ARCH_SUPPORTS
	depends on BR2_TOOLCHAIN_HAS_THREADS
	help
	  Go compiler and cli tool.

	  http://golang.org/
```

## package/php-apcu/Config.in
```kconfig
config BR2_PACKAGE_PHP_APCU
	bool "php-apcu"
	depends on BR2_PACKAGE_PHP
	select BR2_PACKAGE_APC
	help
	  PHP APCU provide PHP OpCode cache

	  http://pecl.php.net/package/acpu
```

## package/php-memcache/Config.in
```kconfig
config BR2_PACKAGE_PHP_MEMCACHE
	bool "php-memcache"
	depends on BR2_PACKAGE_PHP
	select BR2_PACKAGE_APC
	help
	  http://pecl.php.net/package/memcache
```
